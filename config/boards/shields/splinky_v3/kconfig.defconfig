## config/boards/shields/splinky_v3/kconfig.defconfig
```kconfig
# splinky_v3/Kconfig.defconfig
# Copyright (c) 2022 The ZMK Contributors
# SPDX-License-Identifier: MIT

if SHIELD_SPLINKY_V3_LEFT

config ZMK_KEYBOARD_NAME
	default "Charybdis v3"

config ZMK_SPLIT_ROLE_CENTRAL
	default y

endif

if SHIELD_SPLINKY_V3_LEFT || SHIELD_SPLINKY_V3_RIGHT

config ZMK_SPLIT
	default y

endif
```

## config/boards/shields/splinky_v3/kconfig.shield
```kconfig
# splinky_v3/Kconfig.shield
# Copyright (c) 2022 The ZMK Contributors
# SPDX-License-Identifier: MIT

config SHIELD_SPLINKY_V3_LEFT
	def_bool $(shields_list_contains,splinky_v3_left)

config SHIELD_SPLINKY_V3_RIGHT
	def_bool $(shields_list_contains,splinky_v3_right)
```
